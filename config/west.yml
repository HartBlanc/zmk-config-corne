## config/west.yml
```yaml
manifest:
  remotes:
    - name: hartblanc
      url-base: https://github.com/hartblanc

  projects:
    - name: zmk
      remote: hartblanc
      revision: main
      import: app/west.yml
  self:
    path: config
```
